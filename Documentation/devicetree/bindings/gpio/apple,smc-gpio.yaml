## Documentation/devicetree/bindings/gpu/apple,agx.yaml
```yaml
# SPDX-License-Identifier: (GPL-2.0 OR BSD-2-Clause)
%YAML 1.2
---
$id: http://devicetree.org/schemas/gpu/apple,agx.yaml#
$schema: http://devicetree.org/meta-schemas/core.yaml#

title: Apple SoC GPU

maintainers:
  - Sasha Finkelstein <k@chaosmail.tech>

properties:
  compatible:
    oneOf:
      - enum:
          - apple,agx-g13g
          - apple,agx-g13s
          - apple,agx-g14g
          - apple,agx-g14s
          - apple,agx-t6040
          - apple,agx-t6041
          - apple,agx-t8132
          - apple,agx-t8140
          - apple,agx-t8142
      - items:
          - enum:
              - apple,agx-g13c
              - apple,agx-g13d
          - const: apple,agx-g13s
      - items:
          - enum:
              - apple,agx-g14c
              - apple,agx-g14d
          - const: apple,agx-g14s

  reg:
    maxItems: 2

  reg-names:
    maxItems: 2

  power-domains:
    maxItems: 1

  dma-noncoherent: true

  mboxes:
    minItems: 1
    maxItems: 2

  memory-region:
    minItems: 3
    items:
      - description: Region containing GPU MMU TTBs
      - description: Region containing GPU MMU page tables
      - description:
          Region containing a shared handoff structure for VM
          management coordination
      - description:
          Power calibration blob, firmware shared-L2 page or firmware data
          segment
      - description:
          GPU calibration blob, preserved firmware text or firmware
          kernel-window page tables
      - description:
          Shared global variables, preserved firmware data or text segment of
          the loaded GPU firmware
      - description: Loaded GFX firmware TEXT, including its relocated DATA pointer
      - description: Loaded GFX1 firmware TEXT, including its relocated DATA pointer

  memory-region-names:
    minItems: 3
    items:
      - const: ttbs
      - const: pagetables
      - const: handoff
      - enum: [hw-cal-a, shared-l2, fw-data]
      - enum: [hw-cal-b, fw-text, l2-pagetables, gfx-data]
      - enum: [globals, fw-data, fw-text, gfx1-data]
      - const: fw-text
      - const: fw1-text

  apple,t8142-gpu-calibration:
    $ref: /schemas/types.yaml#/definitions/uint8-array
    minItems: 512
    maxItems: 512
    description: |
      Owner-supplied T8142 HAL300 26A434 calibration record, in little endian.
      The four u32 header fields are version (1), SoC ID (0x8142), enabled GPU
      core mask and power sample period in milliseconds. The remaining 496
      bytes are the 103 typed calibration fields of struct Calibration in
      drivers/gpu/drm/asahi/g17/fw/initdata/hal300.rs, in declaration order.
      Documentation/gpu/asahi-t8142.rst fixes the byte positions for version 1.
      These fields carry per-device power coefficients whose firmware meaning
      is not fully known; they are not object offsets or write commands.
      The maximum pstate and maximum frequency must agree with available OPPs.
      The record belongs to the loaded firmware profile and physical device;
      it must not contain firmware, a captured graph or per-boot addresses.
      The boot loader installs the current device's record before enabling
      the GPU. No calibration values are present in source device trees.

  apple,power-sample-period:
    $ref: /schemas/types.yaml#/definitions/uint32
    minimum: 1
    maximum: 10000
    description: T8142 GPU power controller sample period in milliseconds

  apple,clpc:
    $ref: /schemas/types.yaml#/definitions/phandle
    description: |
      Host performance controller receiving GPU submission and idle demand.
      GFX supplier power cannot represent GPU work on firmware that keeps
      its coprocessor domain powered while the cores are idle.

  apple,idle-off-delay-ms:
    minimum: 2
    maximum: 1000
    default: 2
    description:
      Continuous idle time before GPU power-off, in milliseconds. The G17
      backend extends the firmware's native delay with its host idle-hold
      control; an absent property preserves the native policy.

  apple,pmp:
    $ref: /schemas/types.yaml#/definitions/phandle
    description: PMP firmware provider owning the GPU power vote and telemetry

  operating-points-v2: true

  apple,firmware-version:
    $ref: /schemas/types.yaml#/definitions/uint32-array
    minItems: 3
    maxItems: 3
    description:
      Reported macOS version (major, minor, patch) whose boot firmware loaded
      the GPU firmware. Filled in by the boot loader. This is a selection
      hint; the T6040 driver requires the exact loaded image identity.

  apple,cs-opp:
    $ref: /schemas/types.yaml#/definitions/phandle
    description:
      Operating-point table of the GPU's CS clock domain, one voltage cell per
      state.

  apple,afr-opp:
    $ref: /schemas/types.yaml#/definitions/phandle
    description:
      Operating-point table of the GPU's AFR clock domain, one voltage cell
      per state.

  apple,t6040-handoff-version:
    $ref: /schemas/types.yaml#/definitions/uint32
    const: 2
    description:
      Written last by the boot loader after it has filled the T6040 operating
      points, memory regions and per-chip calibration. Absent in the source DT.

  apple,core-mask:
    $ref: /schemas/types.yaml#/definitions/uint32
    description: Enabled cores in the two ten-core T6040 clusters, low cluster first

  apple,max-power-mw:
    $ref: /schemas/types.yaml#/definitions/uint32
    description: Per-chip maximum GPU power in milliwatts, calculated by the loader

  apple,perf-base-pstate:
    $ref: /schemas/types.yaml#/definitions/uint32
    description:
      Logical base state of the frequency-relative performance table. T6040
      supports the first active state, also used when its ADT omits the property.

  apple,perf-map-a:
    $ref: /schemas/types.yaml#/definitions/uint32-array
    description:
      All 16 A selector register fields, indexing raw ADT operating points.
      Eleven populated entries, including off, followed by five zeros.

  apple,perf-map-b:
    $ref: /schemas/types.yaml#/definitions/uint32-array
    description:
      All 16 B selector register fields, indexing raw ADT operating points.
      Eleven populated entries, including off, followed by five zeros.

  apple,perf-relative-a:
    $ref: /schemas/types.yaml#/definitions/uint32-array
    description:
      Per-chip relative power of each populated A selector, in percent,
      followed by zeros for the five unused selectors.

  apple,perf-relative-b:
    $ref: /schemas/types.yaml#/definitions/uint32-array
    description:
      Relative frequency of the populated A ladder above the base state,
      in percent, followed by zeros for the five unused selectors.

  apple,core-leak-coef:
    $ref: /schemas/types.yaml#/definitions/uint32-array
    description:
      GPU core leakage, one coefficient per cluster. Per-chip efuse values decoded by the boot loader,
      stored as IEEE-754 binary32 bit patterns in big-endian cells.

  apple,sram-leak-coef:
    $ref: /schemas/types.yaml#/definitions/uint32-array
    description:
      GPU SRAM leakage, one coefficient per cluster. Per-chip efuse values decoded by the boot loader,
      stored as IEEE-754 binary32 bit patterns in big-endian cells.

  apple,cs-leak-coef:
    $ref: /schemas/types.yaml#/definitions/uint32-array
    description:
      CS leakage. Per-chip efuse values decoded by the boot loader,
      stored as IEEE-754 binary32 bit patterns in big-endian cells.

  apple,afr-leak-coef:
    $ref: /schemas/types.yaml#/definitions/uint32-array
    description:
      AFR leakage. Per-chip efuse values decoded by the boot loader,
      stored as IEEE-754 binary32 bit patterns in big-endian cells.

  apple,firmware-abi:
    $ref: /schemas/types.yaml#/definitions/uint32-array
    minItems: 3
    description:
      macOS version the current firmware is paired with, used to pick
      the version of firmware ABI to be used.
      Bootloader will overwrite this

required:
  - compatible
  - reg
  - mboxes
  - memory-region

allOf:
  - if:
      properties:
        compatible:
          contains:
            const: apple,agx-t8132
    then:
      properties:
        reg:
          items:
            - description: GPU coprocessor control registers
            - description: GPU block MMIO registers
        mboxes:
          maxItems: 1
        reg-names:
          items:
            - const: asc
            - const: sgx
        memory-region:
          minItems: 6
        memory-region-names:
          items:
            - const: ttbs
            - const: pagetables
            - const: handoff
            - const: shared-l2
            - const: fw-text
            - const: fw-data
      required:
        - apple,pmp
        - power-domains
        - reg-names
        - memory-region-names
    else:
      properties:
        apple,pmp: false
  - if:
      properties:
        compatible:
          contains:
            const: apple,agx-t8140
    then:
      properties:
        reg:
          items:
            - description: GFX coprocessor control registers
            - description: GPU block MMIO registers
        reg-names:
          items:
            - const: asc
            - const: sgx
        mboxes:
          items:
            - description: GFX coprocessor mailbox
            - description: GFX1 coprocessor mailbox
        memory-region:
          items:
            - description: Region containing GPU MMU TTBs
            - description: Region containing GPU MMU page tables
            - description:
                Region containing a shared handoff structure for VM
                management coordination
        memory-region-names:
          items:
            - const: ttbs
            - const: pagetables
            - const: handoff
      required:
        - power-domains
        - operating-points-v2
  - if:
      properties:
        compatible:
          contains:
            const: apple,agx-t8142
    then:
      properties:
        reg:
          items:
            - description: GFX coprocessor control registers
            - description: GPU block MMIO registers
        reg-names:
          items:
            - const: asc
            - const: sgx
        mboxes:
          items:
            - description: GFX coprocessor mailbox
            - description: GFX1 coprocessor mailbox
        memory-region:
          minItems: 6
          items:
            - description: GPU MMU TTBs
            - description: GPU MMU page tables
            - description: Shared VM management handoff
            - description: Shared firmware kernel-window page tables
            - description: GFX firmware DATA segment
            - description: GFX1 firmware DATA segment
            - description: Loaded GFX firmware TEXT segment
            - description: Loaded GFX1 firmware TEXT segment
        memory-region-names:
          minItems: 6
          items:
            - const: ttbs
            - const: pagetables
            - const: handoff
            - const: shared-l2
            - const: gfx-data
            - const: gfx1-data
            - const: fw-text
            - const: fw1-text
      required:
        - power-domains
        - reg-names
        - memory-region-names
        - operating-points-v2
  - if:
      properties:
        compatible:
          contains:
            const: apple,agx-t6040
    then:
      properties:
        apple,core-mask:
          minimum: 1
          maximum: 1048575
        apple,max-power-mw:
          minimum: 1
          maximum: 200000
        apple,perf-base-pstate:
          const: 1
        apple,perf-map-a:
          minItems: 16
          maxItems: 16
        apple,perf-map-b:
          minItems: 16
          maxItems: 16
        apple,perf-relative-a:
          minItems: 16
          maxItems: 16
        apple,perf-relative-b:
          minItems: 16
          maxItems: 16
        apple,core-leak-coef:
          minItems: 2
          maxItems: 2
        apple,sram-leak-coef:
          minItems: 2
          maxItems: 2
        apple,cs-leak-coef:
          minItems: 1
          maxItems: 1
        apple,afr-leak-coef:
          minItems: 1
          maxItems: 1
  - if:
      properties:
        compatible:
          contains:
            enum:
              - apple,agx-t6040
              - apple,agx-t6041
    then:
      properties:
        reg:
          items:
            - description: GFX coprocessor control registers
            - description: GPU block MMIO registers
        reg-names:
          items:
            - const: asc
            - const: sgx
        mboxes:
          items:
            - description: GFX coprocessor mailbox
        memory-region:
          items:
            - description: Region containing GPU MMU TTBs
            - description: Region containing GPU MMU page tables
            - description:
                Region containing a shared handoff structure for VM
                management coordination
            - description:
                Data segment of the loaded GPU firmware, where the firmware
                places its crash log
            - description:
                Region in which the GPU firmware builds the page tables of
                its kernel window
            - description:
                Text segment of the loaded GPU firmware, which identifies the
                firmware build
        memory-region-names:
          items:
            - const: ttbs
            - const: pagetables
            - const: handoff
            - const: fw-data
            - const: l2-pagetables
            - const: fw-text
      required:
        - power-domains
        - operating-points-v2
        - apple,cs-opp
        - apple,afr-opp
  - if:
      not:
        properties:
          compatible:
            contains:
              enum:
                - apple,agx-t6040
                - apple,agx-t6041
                - apple,agx-t8132
                - apple,agx-t8140
                - apple,agx-t8142
    then:
      properties:
        reg:
          items:
            - description: GPU coprocessor control registers
            - description: GPU block MMIO registers
        reg-names:
          items:
            - const: asc
            - const: sgx
        mboxes:
          maxItems: 1
        memory-region:
          minItems: 6
        memory-region-names:
          items:
            - const: ttbs
            - const: pagetables
            - const: handoff
            - const: hw-cal-a
            - const: hw-cal-b
            - const: globals
      required:
        - apple,firmware-abi

  - if:
      required:
        - apple,t8142-gpu-calibration
    then:
      properties:
        compatible:
          const: apple,agx-t8142
        memory-region:
          minItems: 8
        memory-region-names:
          minItems: 8
      required:
        - apple,power-sample-period

additionalProperties: false

examples:
  - |
    gpu@6400000 {
        compatible = "apple,agx-g13g";
        reg = <0x6400000 0x40000>,
              <0x4000000 0x1000000>;
        reg-names = "asc", "sgx";
        mboxes = <&agx_mbox>;
        power-domains = <&ps_gfx>;
        memory-region = <&uat_ttbs>, <&uat_pagetables>, <&uat_handoff>,
                        <&gpu_hw_cal_a>, <&gpu_hw_cal_b>, <&gpu_globals>;
        memory-region-names = "ttbs", "pagetables", "handoff",
                              "hw-cal-a", "hw-cal-b", "globals";

        apple,firmware-abi = <0 0 0>;
    };
...
```

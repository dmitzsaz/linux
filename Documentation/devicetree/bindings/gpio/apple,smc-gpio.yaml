## Documentation/devicetree/bindings/soc/apple/apple,j704-platform-data.yaml
```yaml
# SPDX-License-Identifier: (GPL-2.0-only OR BSD-2-Clause)
%YAML 1.2
---
$id: http://devicetree.org/schemas/soc/apple/apple,j704-platform-data.yaml#
$schema: http://devicetree.org/meta-schemas/core.yaml#
title: Apple J704 loader PCIe tuning data
maintainers:
  - Dmitriy <noc@pimk.in>
description: |
  The static DTS contains empty shared, port0 and port2 children. Aura supplies
  validated tables from the current ADT, then publishes format version 1 and
  the ready marker. Each table is a flat sequence of u32 (offset, mask, value)
  triples; the register update is (old & ~mask) | value. The driver validates
  alignment, lengths and individual register-window bounds before hardware use.
$defs:
  table:
    $ref: /schemas/types.yaml#/definitions/uint32-array
    minItems: 3
    maxItems: 12288
    description: Register offset, RMW clear mask and value triples from the ADT.
properties:
  compatible:
    const: apple,j704-platform-data
  apple,format-version:
    $ref: /schemas/types.yaml#/definitions/uint32
    const: 1
    description: Loader tuning contract version.
  apple,pcie-tunables-ready:
    type: boolean
    description: All twelve tuning properties have been validated by the loader.
  shared:
    type: object
    properties:
      apple,tunable-axi2af:
        $ref: '#/$defs/table'
      apple,tunable-phy:
        $ref: '#/$defs/table'
      apple,tunable-pll:
        $ref: '#/$defs/table'
      apple,tunable-auspma:
        $ref: '#/$defs/table'
    additionalProperties: false
patternProperties:
  '^port[02]$':
    type: object
    properties:
      apple,tunable-config:
        $ref: '#/$defs/table'
      apple,tunable-root:
        $ref: '#/$defs/table'
      apple,tunable-gen3:
        $ref: '#/$defs/table'
      apple,tunable-gen4:
        $ref: '#/$defs/table'
    additionalProperties: false
required:
  - compatible
  - shared
  - port0
  - port2
additionalProperties: false
...
```

## Documentation/devicetree/bindings/soc/apple/apple,j704-platform.yaml
```yaml
# SPDX-License-Identifier: (GPL-2.0-only OR BSD-2-Clause)
%YAML 1.2
---
$id: http://devicetree.org/schemas/soc/apple/apple,j704-platform.yaml#
$schema: http://devicetree.org/meta-schemas/core.yaml#
title: Apple J704 PCIe startup coordinator
maintainers:
  - Dmitriy <noc@pimk.in>
description: |
  Coordinates the shared PCIe PHY, radio and SD reader links before publishing
  their dormant DART/host nodes. It waits for the board SMC, consumes the loader
  tuning contract, and pins partial hardware state until reboot. There is no
  userspace stage sequence or module parameter interface.
properties:
  compatible:
    const: apple,j704-platform
  apple,smc:
    $ref: /schemas/types.yaml#/definitions/phandle
    description: SMC provider owning the radio and SD reader power functions.
required:
  - compatible
  - apple,smc
additionalProperties: false
...
```

## Documentation/devicetree/bindings/soc/apple/apple,t8142-memory-performance.yaml
```yaml
# SPDX-License-Identifier: (GPL-2.0-only OR BSD-2-Clause)
%YAML 1.2
---
$id: http://devicetree.org/schemas/soc/apple/apple,t8142-memory-performance.yaml#
$schema: http://devicetree.org/meta-schemas/core.yaml#
title: Apple T8142 memory and fabric performance controls
maintainers:
  - Dmitriy <noc@pimk.in>
description: |
  PMC voter and rail interfaces used to adjust the CLPC memory/fabric floor
  from CPU and GPU demand. The GPU supplies activity registers; the consumer
  waits for its bound driver before sampling those registers.
properties:
  compatible:
    const: apple,t8142-memory-performance
  reg:
    maxItems: 4
  reg-names:
    items:
      - const: voters
      - const: rails
      - const: gpu-core-power
      - const: gpu-pstate
  apple,gpu:
    $ref: /schemas/types.yaml#/definitions/phandle
    description: GPU provider whose activity registers may be sampled after startup.
required:
  - compatible
  - reg
  - reg-names
  - apple,gpu
additionalProperties: false
...
```

## Documentation/devicetree/bindings/sound/apple,t8140-aop-audio.yaml
```yaml
# SPDX-License-Identifier: (GPL-2.0-only OR BSD-2-Clause)
%YAML 1.2
---
$id: http://devicetree.org/schemas/sound/apple,t8140-aop-audio.yaml#
$schema: http://devicetree.org/meta-schemas/core.yaml#

title: Apple T8140 and T8142 AOP audio

maintainers:
  - Ryan Murray <ryan@aurorasilicon.org>

description: |
  The Always-On Processor on Apple T8140 SoCs owns the machine's low-power
  audio paths. This node is a child of the AOP node and describes the DMA
  channels and power domains the host needs in order to drive them, namely
  the internal speaker, the 3.5 mm headset jack in both directions, a serial
  monitor tap on the speaker output, and the high-quality microphone array.

  The low-power microphone uses a shared ring on this node's DART stream.
  The remaining audio data moves over the named ADMAC channels while its AOP
  service is active. T8142 uses base-ns ADMAC for both speakers and the jack;
  its low-power microphone ring is optional and its serializer is firmware-owned. The parent AOP binding describes the firmware transport.

allOf:
  - $ref: dai-common.yaml#
  - if:
      properties:
        compatible:
          contains:
            const: apple,t8142-aop-audio
    then:
      properties:
        dmas:
          maxItems: 4
        dma-names:
          items:
            - const: cout
            - const: cin
            - const: spkr
            - const: sense
        power-domains:
          maxItems: 1
        power-domain-names:
          items:
            - const: mca1
    else:
      properties:
        dmas:
          minItems: 5
        dma-names:
          items:
            - const: spkr
            - const: cout
            - const: cin
            - const: spkr-tap
            - const: hpai
        power-domains:
          minItems: 5
        power-domain-names:
          items:
            - const: tx0
            - const: mca
            - const: mca1
            - const: mca0
            - const: rx0

properties:
  compatible:
    oneOf:
      - const: apple,t8140-aop-audio
      - items:
          - const: apple,t8142-aop-audio
          - const: apple,t8140-aop-audio

  dmas:
    minItems: 4
    maxItems: 5

  dma-names:
    minItems: 4
    maxItems: 5
    items:
      enum: [spkr, cout, cin, spkr-tap, hpai, sense]

  power-domains:
    minItems: 1
    maxItems: 5

  power-domain-names:
    minItems: 1
    maxItems: 5
    items:
      enum: [tx0, mca, mca1, mca0, rx0]

  iommus:
    maxItems: 1

  apple,dma-range:
    $ref: /schemas/types.yaml#/definitions/uint64-array
    minItems: 2
    maxItems: 2
    description: |
      IOVA window the AOP may use for this device's audio buffers, expressed
      as a base followed by its size.

  "#sound-dai-cells":
    const: 1
    description:
      AOP audio DAI identifier. The J700 headset link uses 0 and its speaker
      link uses 4. The T8142 base-ns speaker component uses 5.

  apple,chassis-name:
    $ref: /schemas/types.yaml#/definitions/string
    description:
      Chassis identifier used to name the sound card, matching the
      apple,aop-audio convention.

  apple,machine-kind:
    $ref: /schemas/types.yaml#/definitions/string
    description:
      Human-readable machine name used in the sound card's description.

required:
  - compatible
  - dmas
  - dma-names
  - power-domains
  - power-domain-names
  - iommus
  - apple,dma-range
  - "#sound-dai-cells"
  - apple,chassis-name
  - apple,machine-kind

unevaluatedProperties: false

examples:
  - |
    aop {
        audio {
            compatible = "apple,t8140-aop-audio";
            iommus = <&aop_dart 9>;
            apple,dma-range = <0x100 0x40000000 0x0 0xffff0000>;
            dmas = <&admac_leap_ns 0>, <&admac_base_ns 4>,
                   <&admac_base_ns 5>, <&admac_base_ns 3>,
                   <&admac_leap_s 1>;
            dma-names = "spkr", "cout", "cin", "spkr-tap", "hpai";
            power-domains = <&ps_audio_leap_tx0>, <&ps_audio_leap_mca>,
                            <&ps_audio_mca1_m>, <&ps_audio_mca0_m>,
                            <&ps_audio_leap_rx0>;
            power-domain-names = "tx0", "mca", "mca1", "mca0", "rx0";
            #sound-dai-cells = <1>;
            apple,chassis-name = "J700";
            apple,machine-kind = "MacBook Neo";
        };
    };
```

## Documentation/devicetree/bindings/sound/apple,t8142-aop-audio.yaml
```yaml
# SPDX-License-Identifier: (GPL-2.0-only OR BSD-2-Clause)
%YAML 1.2
---
$id: http://devicetree.org/schemas/sound/apple,t8142-aop-audio.yaml#
$schema: http://devicetree.org/meta-schemas/core.yaml#

title: Apple T8142 AOP audio

maintainers:
  - Ryan Murray <ryan@aurorasilicon.org>

description:
  Audio services of the T8142 Always-On Processor. The firmware runs the
  speaker and headset serializers on base-ns ADMAC and a three-channel
  floating-point microphone array on leap-s ADMAC. There is no low-power
  microphone ring exposed to the host.

allOf:
  - $ref: dai-common.yaml#

properties:
  compatible:
    const: apple,t8142-aop-audio

  dmas:
    items:
      - description: Headset jack output
      - description: Headset microphone input
      - description: Internal speaker output
      - description: Speaker voltage and current sense input
      - description: High-quality microphone array input

  dma-names:
    items:
      - const: cout
      - const: cin
      - const: spkr
      - const: sense
      - const: hpai

  power-domains:
    items:
      - description: Speaker serializer
      - description: Headset serializer
      - description: LEAP secure ADMAC
      - description: LEAP serializer
      - description: LEAP microphone receive channel

  power-domain-names:
    items:
      - const: mca0
      - const: mca2
      - const: leap_s_a
      - const: leap_mca
      - const: leap_rx0

  "#sound-dai-cells":
    const: 1
    description:
      The speaker back-end is 3 and the headset back-end is 4.

  apple,chassis-name:
    $ref: /schemas/types.yaml#/definitions/string
    description: Chassis identifier used to name the microphone sound card.

  apple,machine-kind:
    $ref: /schemas/types.yaml#/definitions/string
    description: Human-readable machine name used in the card description.

required:
  - compatible
  - dmas
  - dma-names
  - power-domains
  - power-domain-names
  - "#sound-dai-cells"
  - apple,chassis-name
  - apple,machine-kind

unevaluatedProperties: false
```
